## script/utils/kickstart-oe/files/board-x86pc.bios.wks
```
part /boot --source bootimg-pcbios --ondisk sda               --label BOOT --active --align 1024
part /     --source rootfs --use-uuid           --fstype=ext4 --label ROOT          --align 1024 --extra-space 512
part                               --ondisk sda --fstype=swap --label SWAP          --align 1024 --size 4096
bootloader --timeout=0 --append="rw rootwait"
```

## script/utils/kickstart-oe/files/board-x86pc.bios_efi64.wks
```
part /boot --source bootimg-biosplusefi --sourceparams="loader=grub-efi" --ondisk sda                          --label BOOT --active --align 1024 --use-uuid
part /     --source rootfs                                               --ondisk sda --use-uuid --fstype=ext4 --label ROOT          --align 1024
part                                                                     --ondisk sda            --fstype=swap --label SWAP          --align 1024 --size 1536
bootloader --ptable gpt --timeout=0 --append="rw rootwait"
```

## script/utils/kickstart-oe/files/board-x86pc.efi64.wks
```
part /boot --source bootimg-efi --sourceparams="loader=grub-efi" --ondisk sda                          --label boot --active --align 1024 --use-uuid
part /     --source rootfs                                       --ondisk sda --use-uuid --fstype=ext4 --label root          --align 1024
part                                                             --ondisk sda            --fstype=swap --label SWAP          --align 1024 --size 1536
bootloader --ptable gpt --timeout=0 --append="rw"
```

## script/utils/kickstart-oe/files/default-gpt.wks
```
part /efi    --source bootimg-partition  --ondisk mmcblk --fstype=vfat --label BOOT --active --offset 65536s --size 384
part /       --source rootfs             --ondisk mmcblk --fstype=ext4 --label ROOT          --align 1024    --extra-space 1024
part                                     --ondisk mmcblk --fstype=swap --label SWAP          --align 1024    --size 1536
bootloader --ptable gpt
```

## script/utils/kickstart-oe/files/default-mbr.wks
```
part /boot --source bootimg-partition  --ondisk mmcblk0 --fstype=vfat --label BOOT --active --align 16384 --size 128
part /     --source rootfs             --ondisk mmcblk0 --fstype=ext4 --label ROOT          --align 1024  --extra-space 512
part                                   --ondisk mmcblk0 --fstype=swap --label SWAP          --align 1024  --size 4096
```

## script/utils/kickstart-oe/files/default.wks
```
part /boot --source bootimg-partition  --ondisk mmcblk --fstype=vfat --label BOOTFS --active --align 16384 --size 64
part /     --source rootfs             --ondisk mmcblk --fstype=ext4 --label ROOTFS          --align 1024  --extra-space 512
```

## script/utils/kickstart-oe/files/g12b-generic.wks
```
# dd if=u-boot.bin of=/dev/disk2 bs=512 seek=1

part /u-boot --source rawcopy --sourceparams="file=@MM_HOME@/images/main/boot/g12bloaderfiles/u-boot.bin" --ondisk mmcblk --no-table
```

## script/utils/kickstart-oe/files/h618-generic.wks
```
# dd if=u-boot-sunxi-with-spl.bin of=/dev/rdisk2 bs=1024 seek=8

part /SPL --source rawcopy --sourceparams="file=@MM_HOME@/images/main/boot/h618loaderfiles/u-boot-sunxi-with-spl.bin" --ondisk mmcblk --no-table --align 8
```

## script/utils/kickstart-oe/files/qcs6490-gpt.wks
```
part /boot   --source bootimg-partition  --ondisk mmcblk --fstype=vfat --label BOOT --align 1024 --size 512
part /       --source rootfs             --ondisk mmcblk --fstype=ext4 --label ROOT --align 1024 --extra-space 512
part                                     --ondisk mmcblk --fstype=swap --label SWAP --align 1024 --size 1536
bootloader --ptable gpt
```

## script/utils/kickstart-oe/files/sm1-generic.wks
```
# dd if=u-boot.bin of=/dev/disk2 bs=512 seek=1

part /u-boot --source rawcopy --sourceparams="file=@MM_HOME@/images/main/boot/sm1loaderfiles/u-boot.bin" --ondisk mmcblk --no-table
```
