## script/utils/kickstart-oe/files/MiniMyth2.wks
```
part /boot --source bootimg-partition  --ondisk mmcblk --fstype=vfat --label BOOTFS --active --align 4096 --size 64
part / --source rootfs --ondisk mmcblk --fstype=ext4 --label ROOTFS --align 4 --extra-space 512
```

## script/utils/kickstart-oe/files/board-g12.radxa_zero.wks
```
# dd if=radxa-zero-uboot.bin of=/dev/disk2 bs=512 seek=1

part /u-boot --source rawcopy --sourceparams="file=@MM_HOME@/images/main/boot/g12aloaderfiles/radxa-zero-uboot.bin" --ondisk mmcblk --no-table --offset 1s
```

## script/utils/kickstart-oe/files/board-h6.wks
```
part /SPL --source rawcopy --sourceparams="file=@MM_HOME@/images/main/boot/h6loaderfiles/u-boot-sunxi-with-spl.bin" --ondisk mmcblk --no-table --align 1
```

## script/utils/kickstart-oe/files/board-rk3328.beelink_a1.wks
```
# SD card preparation with dd
# dd if=idbloader.img of=sdb seek=64
# dd if=uboot.img     of=sdb seek=16384
# dd if=trust.img     of=sdb seek=24576

part /SPL    --source rawcopy --sourceparams="file=@MM_HOME@/images/main/boot/rk3328loaderfiles/idbloader.img" --ondisk mmcblk --no-table --align 32
part /u-boot --source rawcopy --sourceparams="file=@MM_HOME@/images/main/boot/rk3328loaderfiles/uboot.img"     --ondisk mmcblk --no-table --align 8192
part /trust  --source rawcopy --sourceparams="file=@MM_HOME@/images/main/boot/rk3328loaderfiles/trust.img"     --ondisk mmcblk --no-table --align 12288
```

## script/utils/kickstart-oe/files/board-rk3328.wks
```
part /SPL    --source rawcopy --sourceparams="file=@MM_HOME@/images/main/boot/rk3328loaderfiles/idbloader.img" --ondisk mmcblk --no-table --align 32
part /u-boot --source rawcopy --sourceparams="file=@MM_HOME@/images/main/boot/rk3328loaderfiles/uboot.img"     --ondisk mmcblk --no-table --align 8192
part /trust  --source rawcopy --sourceparams="file=@MM_HOME@/images/main/boot/rk3328loaderfiles/trust.img"     --ondisk mmcblk --no-table --align 12288
```

## script/utils/kickstart-oe/files/board-rk3399.orangepi_4.wks
```
part /SPL    --source rawcopy --sourceparams="file=@MM_HOME@/images/main/boot/rk3399loaderfiles/rksd_loader.img" --ondisk mmcblk --no-table --align 32
```

## script/utils/kickstart-oe/files/board-rk3399.orangepi_4_lts.wks
```
# for radxa vendor uboot
# sudo dd if=idbloader.img of=/dev/mmcblk1 seek=64
# sudo dd if=uboot.img of=/dev/mmcblk1 seek=16384
# sudo dd if=trust.img of=/dev/mmcblk1 seek=24576

part /SPL --source rawcopy --sourceparams="file=@MM_HOME@/images/main/boot/rk3399loaderfiles/idbloader.img" --ondisk mmcblk --no-table --align 32
part /SPL --source rawcopy --sourceparams="file=@MM_HOME@/images/main/boot/rk3399loaderfiles/uboot.img"     --ondisk mmcblk --no-table --align 8192
part /SPL --source rawcopy --sourceparams="file=@MM_HOME@/images/main/boot/rk3399loaderfiles/trust.img"     --ondisk mmcblk --no-table --align 12288
```

## script/utils/kickstart-oe/files/board-rk3399.wks
```
part /SPL    --source rawcopy --sourceparams="file=@MM_HOME@/images/main/boot/rk3399loaderfiles/idbloader.img" --ondisk mmcblk --no-table --align 32
part /u-boot --source rawcopy --sourceparams="file=@MM_HOME@/images/main/boot/rk3399loaderfiles/uboot.img"     --ondisk mmcblk --no-table --align 8192
part /trust  --source rawcopy --sourceparams="file=@MM_HOME@/images/main/boot/rk3399loaderfiles/trust.img"     --ondisk mmcblk --no-table --align 12288
```

## script/utils/kickstart-oe/files/board-rk3528.vontar_r3.wks
```
part /SPL --source rawcopy --sourceparams="file=@MM_HOME@/images/main/boot/rk3528loaderfiles/idbloader.img" --ondisk mmcblk --no-table --align 32
part /SPL --source rawcopy --sourceparams="file=@MM_HOME@/images/main/boot/rk3528loaderfiles/u-boot.itb"    --ondisk mmcblk --no-table --align 8192

part /env    --ondisk mmcblk --label env    --offset 32768s --size 15M
part /efi    --source bootimg-partition  --ondisk mmcblk --fstype=vfat --label BOOT --active --offset 65536s --size 512
part /       --source rootfs             --ondisk mmcblk --fstype=ext4 --label ROOT          --align 1024    --extra-space 512
part                                     --ondisk mmcblk --fstype=swap --label SWAP          --align 1024    --size 1536
bootloader --ptable gpt
```

## script/utils/kickstart-oe/files/board-rk3566.quartz64-b.wks
```
# for mainline uboot
# sudo dd if=idbloader.img of=/dev/mmcblk1 seek=64
# sudo dd if=u-boot.itb of=/dev/mmcblk1 seek=16384

part /SPL --source rawcopy --sourceparams="file=@MM_HOME@/images/main/boot/rk3566loaderfiles/idbloader.img" --ondisk mmcblk --no-table --align 32
part /SPL --source rawcopy --sourceparams="file=@MM_HOME@/images/main/boot/rk3566loaderfiles/u-boot.itb"    --ondisk mmcblk --no-table --align 8192
```

## script/utils/kickstart-oe/files/board-rk3566.urve-pi.wks
```
part /loader --source rawcopy --sourceparams="file=@MM_HOME@/images/main/boot/rk3566loaderfiles/idblock.bin" --ondisk mmcblk --no-table --align 32
part /uboot  --source rawcopy --sourceparams="file=@MM_HOME@/images/main/boot/rk3566loaderfiles/uboot.img"   --ondisk mmcblk --no-table --align 8192


part /loader --ondisk mmcblk --label loader --offset 64s    --size 7M
part /uboot  --ondisk mmcblk --label uboot  --offset 16384s --size 7M
part /env    --ondisk mmcblk --label env    --offset 32768s --size 15M
part /efi    --source bootimg-partition  --ondisk mmcblk --fstype=vfat --label BOOT --active --offset 65536s --size 512
part /       --source rootfs             --ondisk mmcblk --fstype=ext4 --label ROOT          --align 1024    --extra-space 512
part                                     --ondisk mmcblk --fstype=swap --label SWAP          --align 1024    --size 4096
bootloader --ptable gpt
```

## script/utils/kickstart-oe/files/board-rk3566.x96_x6.wks
```
part /loader --source rawcopy --sourceparams="file=@MM_HOME@/images/main/boot/rk3566loaderfiles/idblock.bin" --ondisk mmcblk --no-table --align 32
part /uboot  --source rawcopy --sourceparams="file=@MM_HOME@/images/main/boot/rk3566loaderfiles/uboot.img"   --ondisk mmcblk --no-table --align 8192


part /loader --ondisk mmcblk0 --label loader --offset 64s    --size 7M
part /uboot  --ondisk mmcblk0 --label uboot  --offset 16384s --size 7M
part /env    --ondisk mmcblk0 --label env    --offset 32768s --size 15M
part /efi    --source bootimg-partition  --ondisk mmcblk0 --fstype=vfat --label BOOT --active --offset 65536s --size 512
part /       --source rootfs             --ondisk mmcblk0 --fstype=ext4 --label ROOT          --align 1024    --extra-space 512
part                                     --ondisk mmcblk0 --fstype=swap --label SWAP          --align 1024    --size 4096
bootloader --ptable gpt
```

## script/utils/kickstart-oe/files/board-t527.orangepi_4a.wks
```
# dd if=u-boot-sunxi-with-spl.bin of=/dev/rdisk2 bs=1024 seek=8

part /SPL --source rawcopy --sourceparams="file=@MM_HOME@/images/main/boot/t527loaderfiles/extlinux_boot_bin_card.bin" --ondisk mmcblk --no-table --align 8
```
