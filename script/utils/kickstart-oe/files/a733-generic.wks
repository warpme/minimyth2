## script/utils/kickstart-oe/files/t7-generic.wks
```
# dd if=u-boot.bin of=/dev/disk2 bs=512 seek=1

part /u-boot --source rawcopy --sourceparams="file=@MM_HOME@/images/main/boot/t7loaderfiles/u-boot.bin" --ondisk mmcblk --no-table
```
